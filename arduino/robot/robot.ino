/*
  code to run basic functions of robot
*/

#include <LiquidCrystal_I2C.h>
#include <IBusBM.h>
#include <Sabertooth.h>

#define rcinSerial Serial1  //serial port for rc servo input
// #define rcoutSerial Serial3 //serial port for rc sensor data output
#define stSerial Serial3    //serial port for sabartooth motor controller

//initialize objects
IBusBM ibus; // IBus object
LiquidCrystal_I2C lcd(0x27,16,2);  // set the LCD address to 0x27 for a 16 chars and 2 line display
Sabertooth sabertooth(128, stSerial);   //set sabertoth adress to default for packet serial

//IBus input channel desegnations
const int driveCh = 0;
const int turnCh = 1;
const int armCh = 7;
const int modeCh = 8;
//IBus most recent values
int driveVal = 0;
int turnVal = 0;
int modeVal = 0;
//mottor max values
int driveMax = 127;
int turnMax = 127;

void setup() {
  Serial.begin(9600);
  ibus.begin(rcinSerial);
  stSerial.begin(9600); // 9600 is the default baud rate for Sabertooth packet serial.
  sabertooth.autobaud();
  sabertooth.drive(0);    //give sabertooth initial values to mix
  sabertooth.turn(0);
}

void loop() {
  
  //check the state of the arm switch
  if(ibus.readChannel(armCh) != 2000)
  {
    //stop drive
    driveVal = 0;
    sabertooth.drive(0);
    //stop turn
    turnVal = 0;
    sabertooth.turn(0);
  }
  else
  {
    modeVal = ibus.readChannel(modeCh);
    Serial.println(modeVal);
    switch(modeVal)
    {
      case 2000:  //switch value is high (down position)
        //autonomus controll
        ;
          
      default:
        ;
      case 1500:    //swith value is neutral (middle position)
        //stop drive
        driveVal = 0;
        sabertooth.drive(0);
        //stop turn
        turnVal = 0;
        sabertooth.turn(0);
        break;
  
      case 1000:    //switch value is low (up position)
        //update drive from controller
        int inVal = evalInput(ibus.readChannel(driveCh), driveMax);
        driveVal = inVal;
        // Serial.print(driveVal);
        sabertooth.drive(inVal);
        //update turn from controller
        inVal = evalInput(ibus.readChannel(turnCh), turnMax);
        turnVal = inVal;
        // Serial.print(turnVal);
        sabertooth.turn(inVal);
        break;
    }
  }
}

//evaluate drive and turn values from reciever
int evalInput(int val, int max)
{
  //check connection
  if(val == 0){
    return 0;
  }
  //scale raw input
  double temp = val - 1500;
  temp = temp /500;
  temp = temp * max;
  return (int) temp;
}